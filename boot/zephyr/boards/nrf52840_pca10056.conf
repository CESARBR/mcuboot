## boot/zephyr/boards/nrf52840_pca10056.conf
```kconfig
# Serial
CONFIG_SERIAL=y
CONFIG_UART_NRFX=y
CONFIG_UART_INTERRUPT_DRIVEN=y
CONFIG_UART_LINE_CTRL=y

# MCUBoot serial
CONFIG_GPIO=y
CONFIG_MCUBOOT_SERIAL=n
CONFIG_BOOT_SERIAL_CDC_ACM=n
#CONFIG_BOOT_SERIAL_DETECT_PORT="GPIO_1"
#CONFIG_BOOT_SERIAL_DETECT_PIN=6

# no RTT console
#CONFIG_RTT_CONSOLE=n
#CONFIG_USB_UART_CONSOLE=n
#CONFIG_UART_CONSOLE=y
# RTT console
CONFIG_HAS_SEGGER_RTT=y
CONFIG_RTT_CONSOLE=y
CONFIG_UART_CONSOLE=n
# Required by USB
CONFIG_MULTITHREADING=n

# USB
CONFIG_USB=n
CONFIG_USB_DEVICE_STACK=n
CONFIG_USB_DEVICE_PRODUCT="MCUBOOT"
CONFIG_USB_CDC_ACM=n
CONFIG_USB_COMPOSITE_DEVICE=n
CONFIG_USB_MASS_STORAGE=n

# Logging
CONFIG_SYS_LOG_DEFAULT_LEVEL=3
CONFIG_SYS_LOG_OVERRIDE_LEVEL=0
```

## boot/zephyr/boards/nrf52840_pca10059.conf
```kconfig
# The UART is used for Serial Recovery, so logging requires
# an RTT console, which is not available out of the box on this board.
# Disable logging.
CONFIG_BOOT_HAVE_LOGGING=n

# Serial
CONFIG_SERIAL=y
CONFIG_UART_NRFX=y
CONFIG_UART_INTERRUPT_DRIVEN=y
CONFIG_UART_LINE_CTRL=y

# MCUBoot serial
CONFIG_GPIO=y
CONFIG_MCUBOOT_SERIAL=y
CONFIG_BOOT_SERIAL_CDC_ACM=y
CONFIG_BOOT_SERIAL_DETECT_PORT="GPIO_1"
CONFIG_BOOT_SERIAL_DETECT_PIN=6

# RTT console
CONFIG_RTT_CONSOLE=n
CONFIG_USB_UART_CONSOLE=n
CONFIG_UART_CONSOLE=y

# Required by USB
CONFIG_MULTITHREADING=n

# USB
CONFIG_USB=n
CONFIG_USB_DEVICE_STACK=n
CONFIG_USB_DEVICE_PRODUCT="MCUBOOT"
CONFIG_USB_CDC_ACM=y
```

## samples/zephyr/hello-world/boards/nrf52840_pca10056.conf
```kconfig
# Serial
CONFIG_SERIAL=y
CONFIG_UART_NRFX=y
CONFIG_UART_INTERRUPT_DRIVEN=y
CONFIG_UART_LINE_CTRL=y

# MCUBoot serial
CONFIG_GPIO=y

CONFIG_FLASH=y
CONFIG_FLASH_PAGE_LAYOUT=y
CONFIG_MPU_ALLOW_FLASH_WRITE=y

# no RTT console
#CONFIG_RTT_CONSOLE=n
#CONFIG_USB_UART_CONSOLE=n
#CONFIG_UART_CONSOLE=y

# RTT console
CONFIG_HAS_SEGGER_RTT=y
CONFIG_RTT_CONSOLE=y
CONFIG_UART_CONSOLE=n

# Logging
CONFIG_SYS_LOG=y
CONFIG_SYS_LOG_DEFAULT_LEVEL=3
CONFIG_SYS_LOG_OVERRIDE_LEVEL=0
```
